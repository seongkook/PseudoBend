float twopi = 3.14159 * 2;
int sampleInt = 80;
elapsedMicros usec = 0;

float samples[] {0, 0.10394775, 0.205601561, 0.303866711, 0.397698051, 0.486111111, 0.568192411, 0.643108861, 0.710116167, 0.768566145, 0.817912881, 0.85771768, 0.887652749,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 -0.00231013, -0.000580714};
float BOsample[] {0, 0.104528463267653, 0.207911690817759, 0.309016994374947, 0.406736643075800, 0.500000000000000, 0.587785252292473, 0.669130606358858, 0.743144825477394, 0.809016994374948, 0.866025403784439, 0.913545457642601, 0.951056516295154,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 -0.104528463267653, 0};

int phase = 0;
int BO_phase = 0;
boolean play = false;
boolean playBO = false;
int BO_TimeOut = 5000;

int gain = 512;
int offset = 512;

void setup() {
  analogWriteResolution(10);
}

void loop()
{
  if (Serial.available())
  {
    char inChar = (char)Serial.read();
    Serial.println(inChar);
    
    if (inChar == 'a')  // Grain vibration
    {
      usec = 0;
      play = true;
      phase = 0;
    }
    else if (inChar == 'b') // Bottom out
    {
      usec = 0;
      playBO = true;
      phase = 0;
    }
    else if (inChar == 'p')
    {
      gain =  gain + 100;
      Serial.println(gain);
    }
    else if (inChar == 'l')
    {
      gain =  gain - 100;
      Serial.println(gain);
    }
    else if (inChar == 'o')
    {
      offset =  offset + 100;
      Serial.println(offset);
    }
    else if (inChar == 'k')
    {
      offset =  offset - 100;
      Serial.println(offset);
    }
  }
  if (play)
  {
    if (usec > sampleInt)
    {
      analogWrite(A21, (int)(samples[phase] * gain + offset));
      usec = 0;
      if (phase < 180)
      {
        phase ++;
      }
      else
      {
        play = false;
        phase = 0;
      }
    }
  }
  if(playBO)
  {
    if (usec > BO_TimeOut)
    {
      usec = 0;
      switch(BO_phase)
      {
        case 0:
          analogWrite(A21, (int)(1 * gain + offset));
          BO_phase = 1;
        break;
        case 1:
          analogWrite(A21, (int)(-1 * gain + offset));
          BO_phase = 2;
        break;
        case 2:
          analogWrite(A21, (int)(1 * gain + offset));
          BO_phase = 3;
        break;
        case 3:
          analogWrite(A21, (int)(-1 * gain + offset));
          BO_phase = 4;
        break;        
        case 4:
          analogWrite(A21, (int)(offset));
          BO_phase = 0;
          playBO = false;
        break;
      }
    }
  }  
}